## arch/risc-v/src/mbv/Kconfig
```kconfig
#
# For a description of the syntax of this configuration file,
# see the file kconfig-language.txt in the NuttX tools repository.
#

if ARCH_CHIP_MBV

comment "AMD MicroBlaze V Options"

menu "MicroBlaze V ISA extensions"

comment "These must match the MicroBlaze V configuration in Vivado"

config MBV_ISA_M
	bool "M: Integer multiplication and division"
	default y
	select ARCH_RV_ISA_M

config MBV_ISA_A
	bool "A: Atomic instructions"
	default y
	select ARCH_RV_ISA_A

config MBV_ISA_C
	bool "C: Compressed instructions"
	default y
	select ARCH_RV_ISA_C

config MBV_ISA_F
	bool "F: Single-precision floating point"
	default n
	select ARCH_HAVE_FPU
	---help---
		Select this if the core was generated with the floating point
		unit enabled.  This makes ARCH_FPU available, which switches the
		ABI to ilp32f and saves/restores the FP registers on context
		switch.

endmenu # MicroBlaze V ISA extensions

menu "AXI Interrupt Controller"

config MBV_INTC_BASE
	hex "AXI INTC base address"
	default 0x41200000
	---help---
		Base address of the AXI INTC (PG099) whose output drives the
		MicroBlaze V machine external interrupt (MEIP).

config MBV_INTC_NIRQS
	int "Number of AXI INTC interrupt inputs"
	default 32
	range 1 32
	---help---
		Number of interrupt inputs of the AXI INTC (C_NUM_INTR_INPUTS).
		AXI INTC input n is NuttX IRQ RISCV_IRQ_EXT + n, so NR_IRQS is
		RISCV_IRQ_EXT + MBV_INTC_NIRQS.

config MBV_INTC_EDGE_MASK
	hex "AXI INTC edge-triggered inputs mask"
	default 0x00000002
	---help---
		Bit n set means that AXI INTC input n is edge triggered
		(C_KIND_OF_INTR).  Edge-triggered inputs are acknowledged in IAR
		before their handler runs so that a new edge arriving during the
		handler is not lost.  Level-triggered inputs are acknowledged
		after the handler has cleared the request at the source.

		The default matches the QEMU amd-microblaze-v-generic machine,
		where only the AXI UART Lite on input 1 is edge triggered.

config MBV_INTC_HAS_IVR
	bool "AXI INTC has the Interrupt Vector Register (C_HAS_IVR)"
	default y
	---help---
		If disabled, the pending interrupt is found by scanning IPR.

config MBV_INTC_HAS_SIE_CIE
	bool "AXI INTC has SIE/CIE registers (C_HAS_SIE, C_HAS_CIE)"
	default y
	---help---
		If disabled, IER is updated with a read-modify-write sequence
		inside a critical section.

endmenu # AXI Interrupt Controller

menu "AXI Timer (system tick)"

config MBV_TIMER_BASE
	hex "AXI Timer base address"
	default 0x41c00000
	---help---
		Base address of the AXI Timer (PG079) used for the system tick.
		Counter 0 generates the tick interrupt.  Counter 1 is used as a
		free running reference if MBV_TIMER_TICK_CATCHUP is enabled.

config MBV_TIMER_IRQ
	int "AXI Timer AXI INTC input"
	default 0
	range 0 31
	---help---
		AXI INTC input the AXI Timer interrupt is connected to.

config MBV_TIMER_CLK_FREQ
	int "AXI Timer clock frequency (Hz)"
	default 100000000
	---help---
		Frequency of the AXI Timer clock (s_axi_aclk).

config MBV_TIMER_TICK_CATCHUP
	bool "Compensate lost ticks with AXI Timer counter 1"
	default y
	---help---
		Run counter 1 of the system tick AXI Timer as a free running up
		counter (no interrupt) and use it as the time reference: on each
		counter 0 interrupt, one system tick is processed for every tick
		period that has elapsed on counter 1.  This keeps the system time
		correct when tick interrupts are delayed by more than one period
		or are lost, e.g. on QEMU whose AXI Timer model re-arms the period
		late on hosts with coarse timers.

		Disable this if the AXI Timer is configured with a single counter
		(C_ONE_TIMER_ONLY) or counter 1 is needed elsewhere.

endmenu # AXI Timer (system tick)

menu "AXI UART Lite"

config MBV_UARTLITE0
	bool "AXI UART Lite 0"
	default n
	select ARCH_HAVE_SERIAL_TERMIOS
	---help---
		Enable the serial driver for an AXI UART Lite (PG142).  RX and TX
		are interrupt driven.  The port is registered as /dev/ttyS0, or
		as /dev/ttyUL0 if the 16550 driver is enabled as well, and as
		/dev/console if it is selected as the serial console.

if MBV_UARTLITE0

config MBV_UARTLITE0_BASE
	hex "AXI UART Lite 0 base address"
	default 0x40600000

config MBV_UARTLITE0_IRQ
	int "AXI UART Lite 0 AXI INTC input"
	default 1
	range 0 31
	---help---
		AXI INTC input the UART Lite interrupt is connected to.  The
		interrupt is a rising edge: the input must be set in
		MBV_INTC_EDGE_MASK.

config MBV_UARTLITE0_BAUD
	int "AXI UART Lite 0 baud rate"
	default 115200
	---help---
		Baud rate the core was generated with (C_BAUDRATE).  It cannot be
		changed by software and is only reported by TCGETS.

config MBV_UARTLITE0_BITS
	int "AXI UART Lite 0 data bits"
	default 8
	range 5 8
	---help---
		Data bits the core was generated with (C_DATA_BITS).  Only
		reported by TCGETS.

config MBV_UARTLITE0_PARITY
	int "AXI UART Lite 0 parity (0=none, 1=odd, 2=even)"
	default 0
	range 0 2
	---help---
		Parity the core was generated with (C_USE_PARITY, C_ODD_PARITY).
		Only reported by TCGETS.

config MBV_UARTLITE0_RXBUFSIZE
	int "AXI UART Lite 0 receive buffer size"
	default 256

config MBV_UARTLITE0_TXBUFSIZE
	int "AXI UART Lite 0 transmit buffer size"
	default 256

endif # MBV_UARTLITE0

endmenu # AXI UART Lite

choice
	prompt "Serial console"
	default MBV_16550_SERIAL_CONSOLE if 16550_UART && !16550_NO_SERIAL_CONSOLE
	default MBV_UARTLITE0_SERIAL_CONSOLE if MBV_UARTLITE0
	default MBV_NO_SERIAL_CONSOLE
	depends on DEV_CONSOLE
	---help---
		The AXI UART16550 and the AXI UART Lite cannot both be the
		console.  The 16550 console is selected under "16550 Serial
		Console" in the 16550 driver options.  Set that to "No 16550
		serial console" to make the AXI UART Lite the console.

config MBV_16550_SERIAL_CONSOLE
	bool "AXI UART16550"
	depends on 16550_UART && !16550_NO_SERIAL_CONSOLE

config MBV_UARTLITE0_SERIAL_CONSOLE
	bool "AXI UART Lite 0"
	depends on MBV_UARTLITE0
	depends on !16550_UART || 16550_NO_SERIAL_CONSOLE
	select SERIAL_CONSOLE

config MBV_NO_SERIAL_CONSOLE
	bool "No serial console"
	depends on !16550_UART || 16550_NO_SERIAL_CONSOLE

endchoice # Serial console

menu "AXI Quad SPI"

config MBV_SPI0
	bool "AXI Quad SPI 0"
	default n
	select SPI
	---help---
		Enable the SPI master driver for an AXI Quad SPI (PG153) in
		standard SPI mode with 8 bit transfers (C_SPI_MODE = 0,
		C_NUM_TRANSFER_BITS = 8, XIP disabled).  The driver is polled.

if MBV_SPI0

config MBV_SPI0_BASE
	hex "AXI Quad SPI 0 base address"
	default 0x44a00000

config MBV_SPI0_NSS
	int "Number of slave select lines"
	default 1
	range 1 32
	---help---
		Number of slave select outputs (C_NUM_SS_BITS).  SPI device ID
		index n (SPIDEVID_INDEX()) drives slave select output n.

config MBV_SPI0_FIFO_DEPTH
	int "FIFO depth"
	default 16
	range 1 256
	---help---
		Depth of the TX and RX FIFOs (C_FIFO_DEPTH, 16 or 256).  Use 1 if
		the core was generated without FIFOs.

config MBV_SPI0_SCK_FREQUENCY
	int "SCK frequency (Hz)"
	default 12500000
	---help---
		The AXI Quad SPI clock is fixed in hardware to
		ext_spi_clk / C_SCK_RATIO and cannot be changed by software.
		SPI_SETFREQUENCY() returns this value.

endif # MBV_SPI0

endmenu # AXI Quad SPI

menu "AXI EthernetLite"

config MBV_ETHLITE
	bool "AXI EthernetLite"
	default n
	depends on NET && MM_IOB && SCHED_LPWORK
	select ARCH_HAVE_NETDEV_STATISTICS
	---help---
		Enable the network driver for an AXI EthernetLite MAC (PG135),
		registered as eth0.  RX and TX completion are interrupt driven,
		frames are handled on the low priority work queue
		(SCHED_LPWORK).
		The MDIO interface is not used, the carrier is always reported
		as present.

		On hardware the EthernetLite interrupt is a rising edge: set its
		bit in MBV_INTC_EDGE_MASK.  On QEMU the input is level triggered
		and the default mask is correct.

if MBV_ETHLITE

config MBV_ETHLITE_BASE
	hex "AXI EthernetLite base address"
	default 0x40e00000

config MBV_ETHLITE_IRQ
	int "AXI EthernetLite AXI INTC input"
	default 5
	range 0 31

config MBV_ETHLITE_TX_PINGPONG
	bool "TX ping-pong buffers (C_TX_PING_PONG)"
	default n
	---help---
		The core has a second TX buffer.  QEMU's model is used without
		it.

config MBV_ETHLITE_RX_PINGPONG
	bool "RX ping-pong buffers (C_RX_PING_PONG)"
	default n
	---help---
		The core has a second RX buffer.  QEMU's model is used without
		it.

config MBV_ETHLITE_MACADDR_1
	hex "MAC address bytes 0-1"
	default 0x000a
	range 0x0 0xffff
	---help---
		First two bytes of the MAC address (00:0a is the AMD/Xilinx
		OUI).  The address can be changed at run time with ifconfig.

config MBV_ETHLITE_MACADDR_2
	hex "MAC address bytes 2-5"
	default 0x35000122
	range 0x0 0xffffffff

endif # MBV_ETHLITE

endmenu # AXI EthernetLite

endif # ARCH_CHIP_MBV
```
